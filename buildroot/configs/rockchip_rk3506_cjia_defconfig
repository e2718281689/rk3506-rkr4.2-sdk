## buildroot/configs/rockchip_rk3506_cjia_defconfig
```kconfig
#include "base/base.config"
#include "chips/rk3506_arm.config"
#include "fs/vfat.config"
#include "wifibt/wireless.config"
BR2_PACKAGE_ALSA_UTILS=y
BR2_PACKAGE_ALSA_UTILS_AMIXER=y
BR2_PACKAGE_ALSA_UTILS_APLAY=y
BR2_PACKAGE_EVTEST=y
BR2_PACKAGE_HOST_LINUX_HEADERS_CUSTOM_6_1=y
BR2_PACKAGE_LIBGPIOD=y
BR2_PACKAGE_LIBGPIOD_TOOLS=y
BR2_PACKAGE_MHZ=y
BR2_PACKAGE_MPD=y
BR2_PACKAGE_MPD_CDIO_PARANOIA=y
BR2_PACKAGE_MPD_FLAC=y
BR2_PACKAGE_MPD_JACK2=y
BR2_PACKAGE_MPD_MPC=y
BR2_PACKAGE_MPD_OPUS=y
BR2_PACKAGE_MTD=y
BR2_PACKAGE_OPENSSH=y
BR2_PACKAGE_OPENSSH_GEN_KEYS=y
BR2_PACKAGE_RECOVERY=y
BR2_PACKAGE_RECOVERY_NO_UI=y
BR2_PACKAGE_RECOVERY_USE_UPDATEENGINE=y
BR2_PACKAGE_RIPGREP=y
BR2_PACKAGE_ROCKCHIP_RGA=y
BR2_PACKAGE_ROCKCHIP_TEST=y
BR2_ROOTFS_OVERLAY+="board/rockchip/rk3506/fast-display-overlay/"
BR2_ROOTFS_POST_BUILD_SCRIPT+="board/rockchip/rk3506/post-build-fast-display.sh"
# BR2_TARGET_GENERIC_REMOUNT_ROOTFS_RW is not set
BR2_TARGET_ROOTFS_SQUASHFS4_ZSTD=y
BR2_TARGET_ROOTFS_UBI=y
BR2_TARGET_ROOTFS_UBI_SQUASHFS=y
# BR2_TARGET_ROOTFS_UBI_SQUASHFS_STATIC is not set
BR2_TARGET_ROOTFS_UBI_SUBSIZE=2048
BR2_TIME_BITS_64=y
```

## buildroot/package/rtl8723du-bt/Config.in
```kconfig
config BR2_PACKAGE_RTL8723DU_BT
	bool "rtl8723du-bt"
	help
	  Local Realtek USB Bluetooth driver package for RTL8723DU.

	  Installs rtk_btusb and rtl8723du_fw / rtl8723du_config.
```

## buildroot/package/rtl8723du/Config.in
```kconfig
config BR2_PACKAGE_RTL8723DU
	bool "rtl8723du"
	depends on !BR2_s390x
	help
	  Out-of-tree lwfinger rtl8723du USB Wi-Fi driver.

	  https://github.com/lwfinger/rtl8723du
```
